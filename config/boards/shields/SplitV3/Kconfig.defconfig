## config/boards/shields/SplitV3/Kconfig.defconfig
```kconfig
if SHIELD_SPLITV3

config ZMK_KEYBOARD_NAME
    default "SplitV3"

endif

if LVGL

config LV_Z_VDB_SIZE
    default 64

config LV_DPI_DEF
    default 148

config LV_Z_BITS_PER_PIXEL
    default 1

choice LV_COLOR_DEPTH
    default LV_COLOR_DEPTH_1
endchoice

endif
```

## config/boards/shields/SplitV3/Kconfig.shield
```kconfig
config SHIELD_SPLITV3_LEFT
    def_bool $(shields_list_contains,SplitV3_left)

config SHIELD_SPLITV3_RIGHT
    def_bool $(shields_list_contains,SplitV3_right)
```
